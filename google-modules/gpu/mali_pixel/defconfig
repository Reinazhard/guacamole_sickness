## google-modules/gpu/mali_pixel/defconfig
```kconfig
CONFIG_MALI_MEMORY_GROUP_MANAGER=y
CONFIG_MALI_PRIORITY_CONTROL_MANAGER=y
CONFIG_MALI_PROTECTED_MEMORY_ALLOCATOR=y

# TODO(b/344773954): CONFIG_MALI_PIXEL_STATS depends on CONFIG_PIXEL_STAT, which is temporary
# disabled because of missing vendor hooks
# CONFIG_MALI_PIXEL_STATS=y
CONFIG_MALI_PIXEL_GPU_SLC=y
```
